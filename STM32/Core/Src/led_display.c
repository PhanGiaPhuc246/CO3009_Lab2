/*
 * led_display.c
 *
 *  Created on: Oct 7, 2024
 *      Author: Admin
 */

#include "led_display.h"

uint16_t set7SEG[11] = {0x40, 0x79, 0x24, 0x30, 0x19, 0x12, 0x02, 0x78, 0x00, 0x10, 0xFF};
uint16_t reset7SEG[11] = {0xBF, 0x86, 0xDB, 0xCF, 0xE6, 0xED, 0xFD, 0x87, 0xFF, 0xEF, 0x00};

void display7SEG(int num) {
	if (num >= 0 && num <= 9) {
		GPIOA->ODR = (GPIOA->ODR | (set7SEG[num] << 8)) & ~(reset7SEG[num] << 8);
	}
	else {
		GPIOA->ODR = (GPIOA->ODR | (set7SEG[10] << 8)) & ~(reset7SEG[10] << 8);
	}
}

void update7SEG(int index){
    switch (index) {
    case 0:
		HAL_GPIO_WritePin(EN_0_GPIO_Port, EN_0_Pin, GPIO_PIN_RESET);
		HAL_GPIO_WritePin(EN_1_GPIO_Port, EN_1_Pin, GPIO_PIN_SET);
		HAL_GPIO_WritePin(EN_2_GPIO_Port, EN_2_Pin, GPIO_PIN_SET);
		HAL_GPIO_WritePin(EN_3_GPIO_Port, EN_3_Pin, GPIO_PIN_SET);
        break;
    case 1:
		HAL_GPIO_WritePin(EN_0_GPIO_Port, EN_0_Pin, GPIO_PIN_SET);
		HAL_GPIO_WritePin(EN_1_GPIO_Port, EN_1_Pin, GPIO_PIN_RESET);
		HAL_GPIO_WritePin(EN_2_GPIO_Port, EN_2_Pin, GPIO_PIN_SET);
		HAL_GPIO_WritePin(EN_3_GPIO_Port, EN_3_Pin, GPIO_PIN_SET);
        break;
    case 2:
		HAL_GPIO_WritePin(EN_0_GPIO_Port, EN_0_Pin, GPIO_PIN_SET);
		HAL_GPIO_WritePin(EN_1_GPIO_Port, EN_1_Pin, GPIO_PIN_SET);
		HAL_GPIO_WritePin(EN_2_GPIO_Port, EN_2_Pin, GPIO_PIN_RESET);
		HAL_GPIO_WritePin(EN_3_GPIO_Port, EN_3_Pin, GPIO_PIN_SET);
        break;
    case 3:
		HAL_GPIO_WritePin(EN_0_GPIO_Port, EN_0_Pin, GPIO_PIN_SET);
		HAL_GPIO_WritePin(EN_1_GPIO_Port, EN_1_Pin, GPIO_PIN_SET);
		HAL_GPIO_WritePin(EN_2_GPIO_Port, EN_2_Pin, GPIO_PIN_SET);
		HAL_GPIO_WritePin(EN_3_GPIO_Port, EN_3_Pin, GPIO_PIN_RESET);
        break;
	default:
		break;
    }
}

int hour = 15;
int minute = 8;
int second = 50;

void updateClockBuffer() {
    led_buffer[0] = hour / 10;
    led_buffer[1] = hour % 10;
    led_buffer[2] = minute / 10;
    led_buffer[3] = minute % 10;
}

uint16_t setMatrixRow[37][8] = {
		{0x00, 0x7E, 0xFF, 0x91, 0x89, 0xFF, 0x7E, 0x00},       // 0
		{0x00, 0x00, 0x82, 0xFF, 0xFF, 0x80, 0x00, 0x00},       // 1
		{0x00, 0x82, 0xC1, 0xE1, 0xB1, 0x9F, 0x8E, 0x00},       // 2
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		{0x00, 0x00, 0x00, 0x00, 0x00, 0x00, 0x00, 0x00}
};
uint16_t resetMatrixRow[37][8] = {
		{0xFF, 0x81, 0x00, 0x6E, 0x76, 0x00, 0x81, 0xFF},       // 0
		{0xFF, 0xFF, 0x7D, 0x00, 0x00, 0x7F, 0xFF, 0xFF},       // 1
		{0xFF, 0x7D, 0x3E, 0x1E, 0x4E, 0x60, 0x71, 0xFF},       // 2
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		{0xFF, 0xFF, 0xFF, 0xFF, 0xFF, 0xFF, 0xFF, 0xFF}
};

void displayLEDMatrix(char c, int index) {
	if (c >= '0' && c <= '9') {
		GPIOB->ODR = (GPIOB->ODR | (setMatrixRow[c - '0'][index] << 8)) & ~(resetMatrixRow[c - '0'][index] << 8);
	}
	else if (c >= 'A' && c <= 'Z') {
		GPIOB->ODR = (GPIOB->ODR | (setMatrixRow[c - 'A' + 10][index] << 8)) & ~(resetMatrixRow[c - 'A' + 10][index] << 8);
	}
	else {
		GPIOB->ODR = (GPIOB->ODR | (setMatrixRow[36][index] << 8)) & ~(resetMatrixRow[36][index] << 8);
	}
}

uint16_t setMatrixEnable[9] = {0x01, 0x02, 0x04, 0x08, 0x10, 0x20, 0x40, 0x80, 0x00};
uint16_t resetMatrixEnable[9] = {0xFE, 0xFD, 0xFB, 0xF7, 0xEF, 0xDF, 0xBF, 0x7F, 0xFF};

void updateLEDMatrix(int index) {
	if (index >= 0 && index <= 7) {
		GPIOB->ODR = (GPIOB->ODR | setMatrixEnable[index]) & ~resetMatrixEnable[index];
	}
	else {
		GPIOB->ODR = (GPIOB->ODR | setMatrixEnable[8]) & ~resetMatrixEnable[8];
	}
}
